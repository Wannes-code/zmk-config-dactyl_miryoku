## boards/shields/Dactyl_Miryoku/Kconfig.defconfig
```kconfig
if SHIELD_DACTYL_MIRYOKU_L

config ZMK_KEYBOARD_NAME
    default "Dactyl_Miryoku"

config ZMK_SPLIT_ROLE_CENTRAL
    default y

endif

if SHIELD_DACTYL_MIRYOKU_L || SHIELD_DACTYL_MIRYOKU_R

config ZMK_SPLIT
    default y

endif
```

## boards/shields/Dactyl_Miryoku/Kconfig.shield
```kconfig
config SHIELD_DACTYL_MIRYOKU_L
    def_bool $(shields_list_contains,Dactyl_Miryoku_left)

config SHIELD_DACTYL_MIRYOKU_R
    def_bool $(shields_list_contains,Dactyl_Miryoku_right)
```
